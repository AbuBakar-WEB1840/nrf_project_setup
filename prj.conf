## CMakeLists.txt
```
cmake_minimum_required(VERSION 3.20.0)
find_package(Zephyr REQUIRED HINTS $ENV(ZEPHYR BASE))
project(led_blink)
target_sources(app PRIVATE src/main.c)

# to include the file in build
# target_sources(app PRIVATE src/modul1.c)

# for conditional inlcusion in build (as mentioned in Kconfig)
target_sources_ifdef(CONFIG_MODULE_1 app PRIVATE src/modul1.c)
```

## Kconfig
```
# it will include another file Kconfig.zephyr as we do #include in c
source "Kconfig.zephyr"

config MODULE_1             # we can use CONFIG_MODULE_1 in our code
    bool "Enable my function"       #enable my function is a label
    default n               # this is default value, if no other sets this value then it will be n 
                            # if we set it in prj.conf then it will be overwritten
```

## prj.conf
```kconfig
CONFIG_GPIO=y

CONFIG_MODULE_1=y
```

## src/main.c
```c
#include <zephyr/kernel.h>
#include <zephyr/sys/printk.h>
#include <zephyr/drivers/gpio.h>
// #include "modul1.h"

#ifdef CONFIG_MODULE_1
    #include "modul1.h"
#endif

// led
#define led_1 DT_ALIAS(led0)
static struct gpio_dt_spec led1 = GPIO_DT_SPEC_GET(led_1, gpios);

// button
#define btn_1 DT_ALIAS(sw0)
static struct gpio_dt_spec sw0 = GPIO_DT_SPEC_GET(btn_1, gpios);


int main(void){
    if (!gpio_is_ready_dt(&led1)){
        return 0;
    }
    if (!gpio_is_ready_dt(&sw0)){
        return 0;
    }

    // led configuration
    gpio_pin_configure_dt(&led1, GPIO_OUTPUT);
    gpio_pin_set_dt(&led1, 0);

    // button configuration
    gpio_pin_configure_dt(&sw0, GPIO_INPUT);

    int a = 12; int b = 13;

    while (1)
    {   
        int val = gpio_pin_get_dt(&sw0);

        if (val == 1){
            // gpio_pin_toggle_dt(&led1);
            gpio_pin_set_dt(&led1, 1);
            k_msleep(2000);
        }
        gpio_pin_set_dt(&led1, 0);

        // using modu1 function
        #ifdef CONFIG_MODULE_1
            printk("%d + %d: %d\n", a, b, add(a, b));
        #endif
    }
    
}
```

## src/modul1.c
```c
#include "modul1.h"

int add(int a, int b){
    return a+b;
}
```

## src/modul1.h
```c
#ifndef MODUL1_H
#define MODUL1_H

int add(int, int);

#endif //MODUL1_H
```
